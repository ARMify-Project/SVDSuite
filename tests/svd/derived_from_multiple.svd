# Test_Example register map
File version: 1.0
Test_Example device
Registers are 32-bit, read-write, reset 0x0 unless marked. A register's access mark holds for its fields unless they carry their own. Offsets are from the block's base; lines under a group give offsets from that group; [hi:lo] are bit positions; {n}, {i} and the like mark numbered series; 'fields as' and 'values as' point back to an identical list; <NAME> marks a mode.

## Memory map
0x40001000 ADC1 size 0x1000
0x40002000 ADC2 size 0x1000 — Analog-to-Digital Converter
0x40003000 ADC3 size 0x1000

## Interrupts
18 ADC1 (ADC2)

## ADC2 — Analog-to-Digital Converter
Base 0x40002000; register names take the prefix ADC_; register names take the suffix _ADC; alternate view of ADCx
Same registers: ADC1 0x40001000 (register names take the prefix ADC_; register names take the suffix _ADC), ADC3 0x40003000 (register names take the prefix ADC_; register names take the suffix _ADC)
0x00 ADC_ISR — ADC interrupt and status register
  [0] ADRDY
    0=ADC is not ready to start conversion; 1=ADC is ready to start conversion
