# algorithm register map
File version: 1.0
Test_Example device
CPU: CM0 r0p0, little endian, no MPU, no FPU, 4 interrupt priority bits
Registers are access not given, no defined reset value unless marked. A register's access mark holds for its fields unless they carry their own. Offsets are from the block's base; lines under a group give offsets from that group; [hi:lo] are bit positions; {n}, {i} and the like mark numbered series; 'fields as' and 'values as' point back to an identical list; <NAME> marks a mode.

## Memory map
0x40001000 ElementA size 0x1000
0x40002000 PeripheralA size 0x1000
{0x40003000+0x1000*n} Peripheral[{n}] (n=0..1) size 0x1000
0x40005000 PeripheralB size 0x1000
0x40006000 PeripheralC size 0x1000

## ElementA
Base 0x40001000
0x00 ClusterA group — ClusterA description
  0x00 RegisterA
    [0] FieldA
      0=ValueA description; 1=ValueB description

## PeripheralA
Base 0x40002000
0x00 ElementA group — ElementA description
  0x00 ClusterA group — ClusterA description
    0x00 RegisterB
      [0] FieldA
        0=ValueA description; 1=ValueB description

## Peripheral[{n}]
Base 0x40003000; array of 2, step 0x1000
0x00 ElementA group — ElementA description
  0x00 ClusterA group — ClusterA description
    0x00 RegisterB
      [0] FieldA
        0=ValueA description; 1=ValueB description
0x04 ClusterA group — ClusterA description
  0x00 RegisterA
    [0] FieldA
      0=ValueA description; 1=ValueB description

## PeripheralB
Base 0x40005000
Same registers: PeripheralC 0x40006000
0x00 RegisterA
  [0] FieldA
    0=ValueA description; 1=ValueB description
