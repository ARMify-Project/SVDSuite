# test register map
File version: 1.0
Test_Example device
CPU: CM0 r0p0, little endian, no MPU, no FPU, 4 interrupt priority bits
Registers are access not given, no defined reset value unless marked. A register's access mark holds for its fields unless they carry their own. Offsets are from the block's base; lines under a group give offsets from that group; [hi:lo] are bit positions; {n}, {i} and the like mark numbered series; 'fields as' and 'values as' point back to an identical list; <NAME> marks a mode.

## Memory map
{0x40001000+0x1000*n} PeripheralA[{n}] (n=0..1) size 0x1000
0x40003000 PeripheralB size 0x1000
0x40004000 PeripheralC[%s] size 0x1000
0x40006000 PeripheralD size 0x1000
0x40007000 PeripheralE[%s] size 0x1000
0x40009000 PeripheralF size 0x1000
{0x4000A000+0x1000*n} PeripheralG[{n}] (n=0..1) size 0x1000
0x4000C000 PeripheralH size 0x1000
0x4000D000 PeripheralI size 0x1000
0x4000E000 PeripheralJ size 0x1000

## PeripheralA[{n}]
Base 0x40001000; array of 2, step 0x1000
Same registers: PeripheralD 0x40006000, PeripheralI 0x4000D000, PeripheralJ 0x4000E000
0x00 RegisterA
0x04 RegisterB

## PeripheralG[{n}]
Base 0x4000A000; array of 2, step 0x1000
Same registers: PeripheralC[%s] 0x40004000, PeripheralE[%s] 0x40007000
Registers as PeripheralA[{n}].
