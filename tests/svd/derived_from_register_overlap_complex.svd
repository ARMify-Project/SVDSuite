# Test_Example register map
File version: 1.0
Test_Example device
Registers are 16-bit, read-write, reset 0x0 unless marked. A register's access mark holds for its fields unless they carry their own. Offsets are from the block's base; lines under a group give offsets from that group; [hi:lo] are bit positions; {n}, {i} and the like mark numbered series; 'fields as' and 'values as' point back to an identical list; <NAME> marks a mode.

## Memory map
0x40001000 ADC1 size 0x1000 — Analog-to-Digital Converter
0x40002000 ADC2 size 0x1000

## Interrupts
18 ADC1

## ADC1 — Analog-to-Digital Converter
Base 0x40001000; register names take the prefix ADC_; register names take the suffix _ADC; alternate view of ADCx
0x04 r1
0x08 cl1 group — Cluster 1
  0x00 r3 8-bit
  0x04 r4 24-bit
  0x09 r5
0x13 r2 64-bit (reset mask 0xFFFFFFFF)
0x1B cl2 group — Cluster 2
  0x00 r6 32-bit
  0x04 cl3 group — Cluster 3
    0x00 r7 24-bit
    0x07 r8 8-bit
    0x08 r9

## ADC2
Base 0x40002000; register names take the prefix ADC_; register names take the suffix _ADC
Registers as ADC1; these are added or differ:
0x08 r10 144-bit (reset mask 0xFFFFFFFF)
