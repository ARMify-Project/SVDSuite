# value_inheritance register map
File version: 1.0
Test_Example device
CPU: CM0 r0p0, little endian, no MPU, no FPU, 4 interrupt priority bits
Registers are 16-bit, write-only, reset 0xDEADBEEF unless marked. A register's access mark holds for its fields unless they carry their own. Offsets are from the block's base; lines under a group give offsets from that group; [hi:lo] are bit positions; {n}, {i} and the like mark numbered series; 'fields as' and 'values as' point back to an identical list; <NAME> marks a mode.

## Memory map
0x40001000 PeripheralA size 0x1000 — PeripheralA Description
0x40002000 PeripheralB size 0x1000

## Interrupts
0 InterruptA (PeripheralA) — InterruptA Description
1 InterruptB (PeripheralA) — InterruptB Description

## PeripheralA — PeripheralA Description
Base 0x40001000; register names take the prefix Prefix; register names take the suffix Suffix; alternate view of PeripheralB
Same registers: PeripheralB 0x40002000 (register names take the prefix Prefix; register names take the suffix Suffix)
0x00 RegisterA (reset mask 0xDEADC0DE)
