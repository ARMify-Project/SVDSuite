# parser register map
Vendor: ARM Ltd.; Series: ARMCM3; File version: 1.2
This is a description
CPU: CM0+ r1p0, little endian, no MPU, no FPU, 3 interrupt priority bits, 10 interrupts, 2 SAU regions
Address unit: 32 bits
Registers are 32-bit, read-write, reset 0x8001 unless marked. A register's access mark holds for its fields unless they carry their own. Offsets are from the block's base; lines under a group give offsets from that group; [hi:lo] are bit positions; {n}, {i} and the like mark numbered series; 'fields as' and 'values as' point back to an identical list; <NAME> marks a mode.

## Memory map
{0x40002000+0x400*n} Timer[{n}] (n=0..3) blocks up to offset 0xC00 — Timer 1 is a standard timer ...

## Interrupts
3 TIM0 (Timer[{n}]) — This is a description
4 TIM1 (Timer[{n}]) — This is a second description

## Timer[{n}] — Timer 1 is a standard timer ...
Base 0x40002000; register names take the prefix PreTest; register names take the suffix AppendTest; alternate view of TestAlternate; array of 4, step 0x400
{0x0+0x400*i} TimerCtrl{i} (i=0..3) reset 0x0 write-0-clears read-clears range 2..4 write-as-read (alternate view of AltRegister) — Timer Control Register
  [1024n+7:1024n+3] BIT{n} (n=0..3) write-1-clears read-clears range 2..4 write-as-read — test
    0=disabled (The clock source clk0 is turned off.); 1=enabled (The clock source clk1 is running.) | 0=disabled (The UART is turned off.); 1=enabled (The UART is running.)
{0x700+0x400*i} Cluster[{i}] (i=0..3) group (alternate view of ClusterOrig) — This is a cluster
  0x00 ClusterCtrl0 (reset mask 0xFFFF) — Cluster Control Register
  0x00 ClusterCtrl1 (reset mask 0xFFFF) — Cluster Control Register
  0x700 ClusterInner group — Cluster description
    0x700 ClusterInner group — Cluster description

## Licence text in the file
ARM Limited (ARM) is supplying this software for use with Cortex-M processor based microcontroller, but can be equally used for other suitable processor architectures. This file can be freely distributed. Modifications to this file shall be clearly marked. . THIS SOFTWARE IS PROVIDED "AS IS". NO WARRANTIES, WHETHER EXPRESS, IMPLIED. OR STATUTORY, INCLUDING, BUT NOT LIMITED TO, IMPLIED WARRANTIES OF. MERCHANTABILITY AND FITNESS FOR A PARTICULAR PURPOSE APPLY TO THIS SOFTWARE. ARM SHALL NOT, IN ANY CIRCUMSTANCES, BE LIABLE FOR SPECIAL, INCIDENTAL, OR. CONSEQUENTIAL DAMAGES, FOR ANY REASON WHATSOEVER.
