# Test_Example register map
File version: 1.0
Test_Example device
Registers are 32-bit, read-write, reset 0x0 unless marked. A register's access mark holds for its fields unless they carry their own. Offsets are from the block's base; lines under a group give offsets from that group; [hi:lo] are bit positions; {n}, {i} and the like mark numbered series; 'fields as' and 'values as' point back to an identical list; <NAME> marks a mode.

## Memory map
0x40001000 ADC1 size 0x1000 — Analog-to-Digital Converter 1
0x40002000 ADC2 size 0x1000 — Analog-to-Digital Converter 2

## ADC1 — Analog-to-Digital Converter 1
Base 0x40001000
0x00 CL{x} (x=x,y; step 0x8) group — ADC instance {x}
  0x00 CL{x} (x=x,b; step 0x4) — ADC interrupt and status register

## ADC2 — Analog-to-Digital Converter 2
Base 0x40002000
0x00 ADC_ISR — ADC interrupt and status register
